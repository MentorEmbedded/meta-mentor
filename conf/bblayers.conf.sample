## conf/distro/include/toolchain-sanity.inc
```bitbake
# Work around bug in some versions regarding unaligned access
TARGET_CC_ARCH_append_arm = " -mno-unaligned-access"
TARGET_CC_KERNEL_ARCH_append_arm = " -mno-unaligned-access"

def toolchain_sanity_flags(d):
    flags = d.getVar('DEBUG_FLAGS_pn-external-sourcery-toolchain', True)
    if flags is None:
        flags = d.getVar('DEBUG_FLAGS', True)
    return flags.split()

python toolchain_kernel_fixup () {
    d = e.data
    if isinstance(e, bb.event.RecipeParsed) and oe.utils.inherits(d, 'kernel'):
        import re

        toolchain_path = d.getVar('EXTERNAL_TOOLCHAIN', True)
        if not toolchain_path:
            return

        # Work around kernel build error due to unused-but-set-variable + Werror
        version = d.getVar('CSL_VER_GCC', False)
        match = re.match('^([0-9]+\.[0-9]+)', version)
        if match:
            version = match.group(1)
            if [int(element) for element in version.split('.')] >= [4, 6]:
                d.setVar('KERNEL_CC_append', ' -Wno-error=unused-but-set-variable')
                d.setVar('CC_append', ' -Wno-error=unused-but-set-variable')
}
addhandler toolchain_kernel_fixup

python toolchain_sanity_check () {
    if not isinstance(e, bb.event.BuildStarted):
        return

    # Make sure the toolchain actually exists
    toolchain_path = e.data.getVar('EXTERNAL_TOOLCHAIN', True)
    if not toolchain_path:
        return

    d = e.data.createCopy()
    d.finalize()

    toolchain_sysroot = d.getVar('EXTERNAL_TOOLCHAIN_SYSROOT', True)
    if not os.path.exists(toolchain_sysroot):
        bb.fatal('Toolchain sysroot `%s` does not exist, please install or fix your Sourcery toolchain at %s' % (toolchain_sysroot, toolchain_path))

    # Check for a specified required toolchain version for releases
    toolchain_required_version = d.getVar('CSL_VER_REQUIRED', True)
    if toolchain_required_version:
        csl_ver_main = d.getVar('CSL_VER_MAIN', True)
        if csl_ver_main and toolchain_required_version != csl_ver_main:
            bb.fatal('Found toolchain version `%s`, expected `%s`. Please install the supported toolchain.' % (toolchain_required_version, csl_ver_main))

    # Check that debug files are available, to be packaged into -dbg
    if '-g0' in toolchain_sanity_flags(d):
        return

    if not os.path.exists(os.path.join(toolchain_path, 'license')):
        # Assuming use of a CodeBench Lite toolchain
        return

    lib_debugdir = bb.data.expand(os.path.join(toolchain_sysroot, 'lib', '.debug'), d)
    try:
        if os.listdir(lib_debugdir):
            return
    except OSError:
        pass

    bb.error("%s does not exist, or is empty" % lib_debugdir)
    bb.error('You need to install the debug info add-on via Sourcery CodeBench.')
    bb.fatal('Please refer to the trouble-shooting section of the Mentor Embedded Linux Users Manual')
}
addhandler toolchain_sanity_check
```

## conf/distro/mel.conf
```bitbake
require conf/distro/poky.conf

DISTRO = "mel"
DISTRO_NAME = "Mentor Embedded Linux"

require conf/distro/include/mel.conf
```

## conf/layer.conf
```bitbake
BBPATH .= ":${LAYERDIR}"
BBFILES += "${LAYERDIR}/recipes/*/*.bb \
            ${LAYERDIR}/recipes/*/*.bbappend"

# Let us add layer-specific bbappends which are only applied when that
# layer is included in our configuration
BBFILES += "${@' '.join('${LAYERDIR}/%s/recipes*/*/*.bbappend' % layer \
               for layer in BBFILE_COLLECTIONS.split())}"

BBFILE_COLLECTIONS += "mentor"
BBFILE_PRIORITY_mentor = "10"
BBFILE_PATTERN_mentor = "^${LAYERDIR}/"
LAYERDEPENDS_mentor = "core"

PREFERRED_VERSION_udev ??= "182"
```

## conf/local.conf.sample
```bitbake
# What distribution to use. We default to the Mentor Embedded Linux distro.
# To build smaller images, you can choose to use the 'mel-tiny' distro, which
# is based on poky-tiny.
DISTRO = 'mel'

# You need to select a specific machine to target the build with. There are a selection
# of emulated machines available which can boot and run in the QEMU emulator:
# qemuarm, qemumips, qemuppc, qemux86, qemux86-64.
MACHINE ??= "qemux86"

# The path to the installed sourcery toolchain. This defaults to using the one
# from the CodeBench we're installed in.
#EXTERNAL_TOOLCHAIN ?= "/path/to/toolchain"

# Uncomment these, adjusting the path appropriately, to use an external
# toolchain, but rebuild the toolchain's C library from source.
#TCMODE = "external-sourcery-rebuild-libc"
#CSL_SRC_FILE = "/path/to/sourcery/src.tar.gz"

# Uncomment to switch the built toolchain from eglibc to uclibc
#TCLIBC = "uclibc"

# The CORE_IMAGE_EXTRA_INSTALL variable allows extra individual packages to be
# added to any of the images inheriting core-image.bbclass, including the
# "core" images (e.g. core-image-base, core-image-minimal) as well as
# console-image.
#CORE_IMAGE_EXTRA_INSTALL += "bash"

# The EXTRA_IMAGE_FEATURES variable allows groups of packages to be added to
# the generated images. Some of these options are added to certain image types
# automatically. The variable can contain the following options:
#
#  "dbg-pkgs"        - add -dbg packages for all installed packages
#                      (adds symbol information for debugging/profiling)
#  "dev-pkgs"        - add -dev packages for all installed packages
#                      (useful if you want to develop against libs in the image)
#  "tools-sdk"       - add development tools (gcc, make, pkgconfig etc.)
#  "tools-debug"     - add debugging tools (gdb, strace)
#  "tools-profile"   - add profiling tools (oprofile, exmap, lttng valgrind (x86 only))
#  "tools-benchmark" - add benchmarking tools (bonnie++, netperfc, lmbench, etc)
#  "tools-testapps"  - add useful testing tools (ts_print, aplay, arecord etc.)
#  "codebench-debug" - core debug tools for use with codebench. this is
#                      a subset of tools-debug (gdbserver, strace, sftp server)
#  "debug-tweaks"    - make an image suitable for development
#                      e.g. ssh root access has a blank password
#  "x11-mini"        - minimal x11 setup, with window manager and terminal
#  "splash"          - include a splashscreen (default: psplash, but the
#                      particular package can be set with the SPLASH variable)
#
#  These are for particular roles/purposes:
#
#  "nas"             - add tools for a network access storage server (samba, nfs, swat)
#  "print-server"    - add tools for a print server (samba, swat)
#  "router"          - add tools for a router/accesspoint (ipsec-tools, iproute2, iptables, etc)
#
# There are other options that can be used here, see
# meta/classes/image.bbclass and meta/classes/core-image.bbclass for more
# details.

EXTRA_IMAGE_FEATURES = "debug-tweaks ssh-server-openssh codebench-debug tools-profile"

# Uncomment to enable runtime testing with ptest
#USER_FEATURES += "ptest"
#EXTRA_IMAGE_FEATURES += "ptest-pkgs"
#CORE_IMAGE_EXTRA_INSTALL += "ptest-runner"

# Uncomment this to enable inclusion of gdbserver in the codebench-debug
# packagegroup / image feature even when GPLv3 is in INCOMPATIBLE_LICENSE, or
# using a distro which sets it that way (atp).
#ALLOW_GPLV3_GDBSERVER = "1"

# User features lets you manipulate the distro features. To add a distro
# feature, simply add it to USER_FEATURES. To remove, prefix it with ~.
#
# # Disable x11
# USER_FEATURES += "~x11"
#
# Disable 3g by default, as most won't need it.
USER_FEATURES += "~3g"

# Disable near field communication support by default
USER_FEATURES += "~nfc"

# How many tasks bitbake should run in parallel
#BB_NUMBER_THREADS = "4"

# How many jobs 'make' should run in parallel when compiling
#PARALLEL_MAKE = "-j 4"

# Uncomment to exclude GPLv3 software from the build
#INCOMPATIBLE_LICENSE = "GPLv3"

# Uncomment to indicate your acceptance of the Freescale end user license
# agreement. This is needed to use the proprietary components for Freescale
# hardware.
#ACCEPT_FSL_EULA = "1"

# Download files from a mirror
# Uncomment this INHERIT, and define SOURCE_MIRROR_URL
#
#INHERIT += "own-mirrors"
#SOURCE_MIRROR_URL = "file:///cache/downloads"
#SOURCE_MIRROR_URL = "http://myserver/sources"

# Our download directory / cache
DL_DIR ?= "${TOPDIR}/downloads"

# Continue to pull downloads from the MEL install
PREMIRRORS_prepend = ".*://.*/.* file://${MELDIR}/downloads/ \n "

# BitBake has the capability to accelerate builds based on previously built
# output. This is done using "shared state" files which can be thought of as
# cache objects and this variable determines where those files are placed.
SSTATE_DIR ?= "${TOPDIR}/cached-binaries"

# Continue to pull cached binaries from the MEL install
SSTATE_MIRROR_SITES += "file://${MELDIR}/cached-binaries"

# Where to place the build output and temporary artifacts
#
# The default value follows:
#TMPDIR = "${TOPDIR}/tmp"

#
# Package Management configuration
#
# This variable lists which packaging formats to enable. Multiple package backends
# can be enabled at once and the first item listed in the variable will be used
# to generate the root filesystems.
#
#  - 'package_deb' for debian style deb files
#  - 'package_ipk' for ipk files are used by opkg (a debian style embedded package manager)
#  - 'package_rpm' for rpm style packages
#
# We default to ipk:
#PACKAGE_CLASSES ?= "package_ipk"

# SDK/ADT target architecture
#
# This variable specified the architecture to build SDK/ADT items for and means
# you can build the SDK packages for architectures other than the machine you are
# running the build on (i.e. building i686 packages on an x86_64 host._
# Supported values are i686 and x86_64
SDKMACHINE ?= "i686"

# The following is a list of additional classes to use when building which
# enable extra features. Some available options which can be included in this variable
# are:
#   - 'buildstats' to collect build statistics (e.g. task times)
#   - 'buildstats-summary' to show what was built from sstate vs from scratch at
#                          the end of the build (requires buildstats)
#   - 'image-mklibs' to reduce shared library files size for an image
#   - 'image-prelink' in order to prelink the filesystem image
#   - 'image-swab' to perform host system intrusion detection
# NOTE: if listing mklibs & prelink both, then make sure mklibs is before prelink
USER_CLASSES ?= "buildstats buildstats-summary image-mklibs"

# To use mklibs, it must also be explicitly enabled for a given image. Note
# that images built with mklibs will only run the binaries installed at image
# creation time, as it removes symbols from the libraries
#MKLIBS_OPTIMIZED_IMAGES ?= "core-image-minimal"

# Interactive shell configuration
#
# Under certain circumstances the system may need input from you and to do this it
# can launch an interactive shell. It needs to do this since the build is
# multithreaded and needs to be able to handle the case where more than one parallel
# process may require the user's attention. The default is iterate over the available
# terminal types to find one that works.
#
# Examples of the occasions this may happen are when resolving patches which cannot
# be applied, to use the devshell or the kernel menuconfig
#
# Supported values are auto, gnome, xfce, rxvt, screen, konsole (KDE 3.x only), none
# Note: currently, Konsole support only works for KDE 3.x due to the way
# newer Konsole versions behave
#OE_TERMINAL = "auto"

# Uncomment to automatically spawn a terminal if a patch fails to apply
#PATCHRESOLVE = "user"

# Archive the source and put them to ${DEPLOY_DIR}/sources/. This is
# particularly useful for license compliance.
#
#INHERIT += "archiver"
#
# The tarball for the patched source will be created by default, and you
# can configure the archiver as follow:
#
# Create archive for:
# 1) original (or unpacked) source:
#ARCHIVER_MODE[src] = "original"
# 2) patched source: (default)
#ARCHIVER_MODE[src] = "patched"
# 3) configured source:
#ARCHIVER_MODE[src] = "configured"
#
# 4) the patches between do_unpack and do_patch:
#ARCHIVER_MODE[diff] = "1"
# set the files that you'd like to exclude from the diff:
#ARCHIVER_MODE[diff-exclude] ?= ".pc autom4te.cache patches"
#
# 5) the environment data, similar to 'bitbake -e recipe':
#ARCHIVER_MODE[dumpdata] = "1"
#
# 6) the recipe (.bb and .inc):
#ARCHIVER_MODE[recipe] = "1"
#
# 7) Whether output the .src.rpm package:
#ARCHIVER_MODE[srpm] = "1"
#

# 8) Filter the license, the recipe whose license in COPYLEFT_LICENSE_INCLUDE
# will be included, and in COPYLEFT_LICENSE_EXCLUDE will be excluded. These
# variables affect both archiver and copyleft_compliance (similar to archiver,
# but lighter and less flexible)
COPYLEFT_LICENSE_INCLUDE = "GPL* LGPL*"
COPYLEFT_LICENSE_EXCLUDE = "CLOSED Proprietary* Mentor Freescale EULA INTEL NetLogic"

# Alternative to the above archiver class. Doesn't support srpm, patched or
# configured source, diff generation, metadata, etc. Only emits original
# pristine source from SRC_URI with patch series file. Upside is it symlinks,
# so its tasks run very quickly, and it bypasses sstate (binary caching), so
# we don't bloat up our SSTATE_DIR with source which already lives in DL_DIR.
#INHERIT += "copyleft_compliance"

# Disk Space Monitoring during the build
#
# Monitor the disk space during the build. If there is less that 1GB of space or less
# than 100K inodes in any key build location (TMPDIR, DL_DIR, SSTATE_DIR), gracefully
# shutdown the build. If there is less that 100MB or 1K inodes, perform a hard abort
# of the build. The reason for this is that running completely out of space can corrupt
# files and damages the build in ways which may not be easily recoverable.
BB_DISKMON_DIRS = "\
    STOPTASKS,${TMPDIR},1G,100K \
    STOPTASKS,${DL_DIR},1G,100K \
    STOPTASKS,${SSTATE_DIR},1G,100K \
    ABORT,${TMPDIR},100M,1K \
    ABORT,${DL_DIR},100M,1K \
    ABORT,${SSTATE_DIR},100M,1K"

# Shared-state files from other locations
#
# The SSTATE_MIRROR_SITES variable can be used to configure the system to
# search other mirror locations for these objects before it builds the data
# itself.
#
# This can be a filesystem directory, or a remote url such as http or ftp.
# These would contain the sstate-cache results from previous builds (possibly
# from other machines). This variable works like fetcher MIRRORS/PREMIRRORS
# and points to the cache locations to check for the shared objects.
#
#SSTATE_MIRROR_SITES += "http://mymirror/sstate"
#SSTATE_MIRROR_SITES += "\
#    http://someserver.tld/share/sstate \
#    file:///some/local/dir \
#"

# Uncomment following lines to enable sysvinit
#VIRTUAL-RUNTIME_init_manager = "sysvinit"
#VIRTUAL-RUNTIME_initscripts = "initscripts"
#DISTRO_FEATURES_BACKFILL_CONSIDERED = ""
#DISTRO_FEATURES_remove = " systemd"

# This may be used to abort the build when using an untested/unverified
# version of the external toolchain.
#SOURCERY_VERSION_REQUIRED = "2012.03"

# Uncomment to enable split-debug filesystem
#SPLIT_DEBUG_FS = "true"
#
# Use this to add extra packages to the split-debug filesystem
#EXTRA_DEBUG_PACKAGES = "ltrace strace"

# CONF_VERSION is increased each time build/conf/ changes incompatibly and is used to
# track the version of this file when it was generated. This can safely be ignored if
# this doesn't mean anything to you.
CONF_VERSION = "1"
```
