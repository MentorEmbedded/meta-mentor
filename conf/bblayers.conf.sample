## conf/bblayers.conf.sample
```bitbake
LCONF_VERSION = "7"

TOPDIR := "${@os.path.dirname(os.path.dirname(FILE))}"
BBPATH = "${TOPDIR}:${HOME}/.oe"
BBFILES ?= ""

BBLAYERS ?= ""
```

## conf/distro/include/expandvars.inc
```bitbake
EARLY_EXPANDED_VARS ?= ""
EARLY_EXPANDED_VARS[type] = "list"

python expand_vars_eh() {
    if isinstance(e, bb.event.ConfigParsed):
        def expand_vars(d):
            for var in oe.data.typed_value('EARLY_EXPANDED_VARS', d):
                d.setVar(var, d.getVar(var, True))

        expand_vars(e.data)
}
addhandler expand_vars_eh
```

## conf/distro/include/knobs.inc
```bitbake
AVAILABLE_KNOBS += "\
    audio \
    benchmark \
    bluetooth \
    framebuffer \
    host-diskdrive \
    host-usb \
    nas \
    print-server \
    router \
    tests \
    wifi \
    x11-minimal \
    \
    ${@base_contains('MACHINE_FEATURES', 'lttng', 'lttng', '', d)} \
    ${@base_contains('MACHINE_FEATURES', 'lttng2', 'lttng2', '', d)} \
"

PACKAGE_GROUP_sb-base = '\
    base-files base-passwd busybox-httpd openssh openssh-sftp-server \
    modutils-initscripts netbase update-alternatives update-rc.d gdbserver \
    kernel-vmlinux kernel-modules procps psmisc crashme ethtool \
    oprofile strace tcpdump sysstat net-tools util-linux \
'

PACKAGE_GROUP_lttng              = 'lttng-control lttng-ust'
PACKAGE_GROUP_lttng2             = 'lttng-tools lttng-modules lttng2-ust'

VALGRIND ?= ""
VALGRIND_powerpc ?= "valgrind"
VALGRIND_powerpc64 ?= "valgrind"
PACKAGE_GROUP_native-development = '\
    gcc gcc-symlinks g++ g++-symlinks cpp cpp-symlinks ldd \
    binutils binutils-symlinks gdb linux-libc-headers file bash \
    perl-modules libtool libtool-dev libltdl-dev \
    make virtual-libc-dev bison flex libstdc++-dev automake autoconf \
    m4 u-boot-mkimage dtc ${VALGRIND} \
'

# For compatibility
PACKAGE_GROUP_audio           = 'alsa-utils'
PACKAGE_GROUP_audio+bluetooth = 'libasound-module-bluez'
PACKAGE_GROUP_benchmark       = 'task-tools-benchmark'
PACKAGE_GROUP_bluetooth       = 'task-base-bluetooth'
PACKAGE_GROUP_host-diskdrive  = 'task-base-ext2 e2fsprogs-tune2fs e2fsprogs-badblocks mdadm'
PACKAGE_GROUP_host-usb        = 'task-base-ext2 e2fsprogs-tune2fs e2fsprogs-badblocks'
PACKAGE_GROUP_inflexion       = 'libpng'
PACKAGE_GROUP_framebuffer     = 'psplash'
PACKAGE_GROUP_wifi            = 'task-base-wifi'
PACKAGE_GROUP_x11-minimal     = '${PACKAGE_GROUP_x11-mini}'
PACKAGE_GROUP_tests              = ''
```

## conf/distro/include/mel-providers.conf
```bitbake
PREFERRED_PROVIDER_gdbserver          ??= "gdbserver"
PREFERRED_PROVIDER_jpeg               ??= "jpeg"
PREFERRED_PROVIDER_jpeg-native        ??= "jpeg-native"
PREFERRED_PROVIDER_rpcbind            ??= "rpcbind"
PREFERRED_PROVIDER_virtual/gettext    ??= "gettext"
PREFERRED_PROVIDER_libx11             ??= "libx11"
```

## conf/distro/include/mel-versions.conf
```bitbake
PREFERRED_VERSION_udev ?= "182"
PREFERRED_VERSION_udev_am37x-evm = "164"
PREFERRED_VERSION_udev_dm37x-evm = "164"
PREFERRED_VERSION_gettext        ?= "0.18.3.1"
PREFERRED_VERSION_gettext-native ?= "0.18.3.1"
PREFERRED_VERSION_binutils        ?= "2.23.2"
PREFERRED_VERSION_binutils-native ?= "2.23.2"

include conf/distro/include/qt5-versions.inc
```

## conf/distro/include/mel-versions.inc
```bitbake
PREFERRED_VERSION_udev ?= "182"
PREFERRED_VERSION_udev_am37x-evm = "164"
PREFERRED_VERSION_udev_dm37x-evm = "164"
```

## conf/distro/include/mel.conf
```bitbake
DISTRO_VERSION = "2013.08+snapshot-${DATE}"
MAINTAINER = "Mentor Graphics Corporation <embedded_support@mentor.com>"
TARGET_VENDOR = "-mel"
SDK_VENDOR = "-melsdk"
SDK_VERSION := "${@'${DISTRO_VERSION}'.replace('snapshot-${DATE}','snapshot')}"
SDKPATH = "/opt/${DISTRO}/${SDK_VERSION}"

# Target i686 for the sdk binaries, rather than the build arch.
#
# Other options: i586, x86_64
SDKMACHINE ?= "i686"

# Paths
MELDIR ?= "${COREBASE}/.."
DEPLOY_DIR_IMAGE = "${DEPLOY_DIR}/images/${PACKAGE_ARCH}"

# Application Development Environment
ADE_PROVIDER = "Mentor Graphics Corporation"
ADE_SITENAME = "Application Development Environment for ${DISTRO_NAME}"
ADE_SECTIONS = "devel bootloaders kernel source sdk"
ADE_SECTIONS_EXCLUDED = "locale"

require conf/distro/include/mel-providers.conf
require conf/distro/include/mel-vardeps.conf

# Ensure we can fetch from private github repositories with https
FETCHCMD_wget += "--auth-no-challenge"

INHERIT_DISTRO ?= "debian devshell sstate license deploy-license-manifest"

# Ensure that all listed licenses show up in the manifest, even if the license
# files weren't populated for that recipe/package.
INHERIT_DISTRO += "license-fixup"

# Configure non-linux-yocto kernels for lttng
INHERIT += "kernel-lttng"

# Support USER_FEATURES
INHERIT += "user_features"

# Use an isolated shared state directory. The user specified SSTATE_DIR will
# still be used, and updated, but the actual SSTATE_DIR used by bitbake will
# be under TMPDIR. This ensures that we can identify what shared state
# archives were used by this build, and means mel-release will only archive
# those shared state archives, not the entire shared SSTATE_DIR, if one
# exists.
INHERIT += "isolated-sstate-dir"

# Move the persist db up out of TMPDIR so it survives its removal
PERSISTENT_DIR = "${TOPDIR}/db"

# Do an up front type check to sanity check user configuration
INHERIT += "typecheck"

# Restore any available saved headrevs
DUMP_HEADREVS_DB ?= '${MELDIR}/${MACHINE}/saved_persist_data.db'
INHERIT += "restore-dumped-headrevs"

# Enable kernel config fragments
INHERIT += "kernel-config-fragments"

# Ensure we get both 32 and 64 bit pseudo on 64 bit hosts
NO32LIBS ?= "0"

# Make our libdir obey BASE_LIB from the tuning files by default
MULTILIBS ?= ""
require conf/multilib.conf

# Mask out the TI angstrom/systemd requirements
BBMASK ?= "/meta-ti/recipes-misc/|/meta-systemd/meta-efl/|/meta-systemd/meta-multimedia/|/meta/recipes-core/meta/external-sourcery-toolchain.bb"

# Lower the priority of meta-oe, as we prefer oe-core when recipes are duped
BBFILE_PRIORITY_openembedded-layer = "1"

# locales shouldn't be in lib32/lib64
localedir = "${exec_prefix}/lib/locale"

# Ensure that we implement shared state reuse handling for non-target recipes
require conf/distro/include/sstate.inc

# Ensure the emitted locale packages are in that section, so they can be
# easily excluded from the ADE (or categorized correctly, when included)
LOCALE_SECTION = "locale"

# A problem we have is that while the info page for ld says that sysv is the
# default in RHEL5, it is actually not and it defaults to gnu hash.  This
# in turn results in binaries that won't run on older systems.  We change to
# forcing both hash types to be included to fix this issue.
BUILD_LDFLAGS += "-Wl,--hash-style=both"

# Additional filesystem types
IMAGE_CLASSES ?= "image_types_uboot image_types_mentor"

# Default to these image types
IMAGE_FSTYPES ?= "tar.bz2 ext3"
UBI_VOLNAME = "rootfs"

# Quadruple the normal. 'du' is not a good way to really see how much
# space will be needed and fails badly as the fs size grows.
IMAGE_ROOTFS_EXTRA_SPACE = "40960"

# Add nls if we're supporting.
DISTRO_FEATURES_append = " ${@['','nls'][bb.data.getVar('USE_NLS', d, 1) == 'yes']}"
DISTRO_FEATURES_append = " vfat"

# Sane default locales for images
GLIBC_GENERATE_LOCALES ?= "en_US en_US.UTF-8"
IMAGE_LINGUAS ?= "en-us"

# Targets for qemu
QEMU_TARGETS += "mips64 mips64el sh4"

# We prefer busybox rather than tinylogin
VIRTUAL-RUNTIME_login_manager = "busybox"

# Use a local PR server by default
PRSERV_HOST ?= "localhost:0"

# Prefer the chkconfig C implementation of alternatives
VIRTUAL-RUNTIME_update-alternatives = "chkconfig-alternatives"
PREFERRED_PROVIDER_virtual/update-alternatives = "chkconfig-alternatives"
PREFERRED_PROVIDER_virtual/update-alternatives-native = "chkconfig-alternatives-native"

# We want information about image contents
INHERIT += "buildhistory"
BUILDHISTORY_DIR ?= "${TOPDIR}/buildhistory"
BUILDHISTORY_COMMIT ?= "1"

# Ensure our external toolchain is sane
require conf/distro/include/toolchain-sanity.inc

# Add symlink to ${KERNEL_IMGTYPE}
require conf/distro/include/kernel-link.inc

# Default to ipk packaging
PACKAGE_CLASSES ?= "package_ipk"

# Force early expansion of recursing package vars
PACKAGE_CLASSES += " package_early_expand"

# More sane usability for the archiver classes
ARCHIVER_MODE ?= "none"
ARCHIVER_MODE[type] = "choice"
ARCHIVER_MODE[choices] = "none original patched configured"
ARCHIVER_CLASS = "${@'archive-${ARCHIVER_MODE}-source' \
                     if ARCHIVER_MODE != 'none' else ''}"
INHERIT += "${ARCHIVER_CLASS}"

# Ensure we have license-filtered sources available
COPYLEFT_LICENSE_INCLUDE = '*'
COPYLEFT_LICENSE_EXCLUDE = 'CLOSED Proprietary* Mentor Freescale EULA INTEL NetLogic'
COPYLEFT_RECIPE_TYPES ?= '${COPYLEFT_AVAILABLE_RECIPE_TYPES}'
INHERIT += "copyleft_compliance"

# Break up copyleft for use by archive-release
INHERIT += "extra_layerinfo"
COPYLEFT_SOURCES_BASE_DIR ?= '${DEPLOY_DIR}/release-downloads'
RECIPE_LAYER_BASENAME = "${@os.path.basename(get_layer_rootdir(RECIPE_LAYERPATH, d))}"
COPYLEFT_SOURCES_DIR = '${COPYLEFT_SOURCES_BASE_DIR}/${RECIPE_LAYER_BASENAME}'

# Ensure we have what we need for the below type checks
OE_IMPORTS += "oe.terminal"

# Default to no automatic spawned terminals -- expicit is better than implicit
PATCHRESOLVE = "noop"

# Defaults for meta-ti machines missing it, as some recipes require it
MACHINE_KERNEL_PR_beagleboard ?= "r1"

# Additional distros we test on
SANITY_TESTED_DISTROS += "\
    Ubuntu 10.04.1 LTS \n \
    CentOS release 5.4 (Final) \n \
    CentOS release 5.5 (Final) \n \
    CentOS release 5.6 (Final) \n \
    CentOS release 5.7 (Final) \n \
    CentOS release 5.8 (Final) \n \
    CentOS release 5.9 (Final) \n \
"

# We aren't quite so picky as poky
WARN_QA = "textrel useless-rpaths rpaths staticdev ldflags"
ERROR_QA = "dev-so debug-deps dev-deps debug-files arch la2 pkgconfig la perms"

# Disable reliance upon upstream URIs, as we want our customers to be able to
# build without network connectivity
CONNECTIVITY_CHECK_URIS = ""

# Work around do_populate_lic(sstate_create_package) / do_rootfs race
# Without this, bitbake defaults the dirs to ${B}, which do_rootfs removes due
# to its cleandirs for recipes where ${B} == ${S}.
sstate_create_package[dirs] = "${TOPDIR}"

# Default to the Xorg X server
XSERVER ?= "\
    xserver-xorg \
    xf86-input-evdev \
    xf86-input-mouse \
    xf86-input-keyboard \
    xf86-video-fbdev \
"

# Package groups
PACKAGE_GROUP_tools-benchmark ?= 'packagegroup-tools-benchmark'
PACKAGE_GROUP_codebench-debug ?= 'gdbserver strace openssh-sftp-server'
PACKAGE_GROUP_nas             ?= 'packagegroup-role-nas'
PACKAGE_GROUP_print-server    ?= 'packagegroup-role-print-server'
PACKAGE_GROUP_router          ?= "packagegroup-role-router"

# Analogous to the nfs-server group
PACKAGE_GROUP_samba-server    ?= "samba swat"

require conf/distro/include/mel-versions.conf

# Ensure that the license manifest is complete. Currently, the manifest code
# skips emission of licenses which aren't in deploy/licenses, and does so
# nearly silently. A warning is printed, but it's only visible in the
# do_rootfs task log. This ensures the populate_lic task is run for the deps
# of an image, until the bug is fixed.
do_rootfs[recrdeptask] += "do_populate_lic"

# Bugfix: ensure that changes to INCOMPATIBLE_LICENSE change the checksum of
# affected do_package tasks
do_package[vardeps] += "${@' '.join('LICENSE_EXCLUSION-%s' % p for p in PACKAGES.split())}"

# Sanely handle the GPLv3 gdbserver coming from external-sourcery-toolchain
require conf/distro/include/gdbserver-gplv3.inc
```

## conf/distro/include/qt5-versions.conf
```bitbake
QT5VERSION ?= "5.1.0"

PREFERRED_VERSION_qtdeclarative = "${QT5VERSION}"
PREFERRED_VERSION_qtbase = "${QT5VERSION}"
PREFERRED_VERSION_qtimageformats = "${QT5VERSION}"
PREFERRED_VERSION_qtgraphicaleffects = "${QT5VERSION}"
PREFERRED_VERSION_qtjsbackend = "${QT5VERSION}"
PREFERRED_VERSION_qtjsbackend-native = "${QT5VERSION}"
PREFERRED_VERSION_qtsvg = "${QT5VERSION}"
PREFERRED_VERSION_qtxmlpatterns = "${QT5VERSION}"
PREFERRED_VERSION_qtmultimedia = "${QT5VERSION}"
PREFERRED_VERSION_qtwebkit-examples = "${QT5VERSION}"
PREFERRED_VERSION_qtquick1 = "${QT5VERSION}"
PREFERRED_VERSION_qtscript = "${QT5VERSION}"
PREFERRED_VERSION_qtbase-native = "${QT5VERSION}"
PREFERRED_VERSION_qtwebkit = "${QT5VERSION}"
```

## conf/distro/include/sstate.inc
```bitbake
INHERIT += "sstate-mirror-sites"

# We know RHEL 6 is the oldest distro we support, and that binaries built
# there will run on any other host we support
SSTATE_MIRROR_DISTROS = "RedHatEnterprise-6"

def lsb_distro_adjust(distro_id, ver):
    """This hook ensures that RHEL server, RHEL client, and CentOS all return
    'RedHatEnterprise' for distro, and just the major part for the version, as
    we know minor versions for these distros are compatible, and these distros
    are compatible with one another."""

    if distro_id in ('RedHatEnterpriseClient', 'RedHatEnterpriseServer',
                     'CentOS'):
        distro_id = 'RedHatEnterprise'

        try:
            major_ver, _ = ver.split('.', 1)
        except ValueError:
            pass
        else:
            ver = major_ver
    return distro_id, ver

LSB_DISTRO_ADJUST = "lsb_distro_adjust"
```
