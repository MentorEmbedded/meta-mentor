## meta-mel-support/conf/layer.conf
```bitbake
BBPATH .= ":${LAYERDIR}"
BBFILES += "${LAYERDIR}/recipes-*/*/*.bb"
BBFILES += "${LAYERDIR}/recipes-*/*/*.bbappend"

# Let us add layer-specific files which are only applied when that
# layer is included in our configuration
BBFILES += "${@' '.join('${LAYERDIR}/%s/recipes*/*/*.bb' % layer \
               for layer in BBFILE_COLLECTIONS.split())}"

LAYERDIR_RE ?= "${LAYERDIR}"
BBFILE_COLLECTIONS += "mel-support"
BBFILE_PRIORITY_mel-support = "4"
BBFILE_PATTERN_mel-support = "^${LAYERDIR_RE}/"
LAYERDEPENDS_mel-support = "core mentor-common"
LAYERSERIES_COMPAT_mel-support = "thud warrior zeus dunfell"

PREFERRED_PROVIDER_virtual/nativesdk-update-alternatives ??= "nativesdk-opkg-utils"
PREFERRED_PROVIDER_chkconfig-alternatives ??= "chkconfig-alternatives"
```

## meta-mel/conf/distro/include/ade-version.inc
```bitbake
ADE_TIMESTAMP := "${@str(int(time.time()))}"
ADE_VERSION ?= "${@'${SDK_VERSION}'.replace('+snapshot', '')}.${ADE_TIMESTAMP}"

python ade_version_setup () {
    e.data.appendVar("BB_HASHCONFIG_WHITELIST", " ADE_TIMESTAMP")
}
ade_version_setup[eventmask] = "bb.event.ConfigParsed"
addhandler ade_version_setup
```

## meta-mel/conf/distro/include/gdbserver-gplv3.inc
```bitbake
# ---------------------------------------------------------------------------------------------------------------------
# SPDX-License-Identifier: MIT
# ---------------------------------------------------------------------------------------------------------------------

# If ALLOW_GPLV3_GDBSERVER is set, allow {L,}GPLv3 for the gdb recipes
ALLOW_GPLV3_GDBSERVER ?= ""
INCOMPATIBLE_LICENSE_EXCEPTIONS += "\
    ${@'gdbserver-external:GPL-3.0 gdb:GPL-3.0' if '${ALLOW_GPLV3_GDBSERVER}' else ''} \
    ${@'gdb:LGPL-3.0' if '${ALLOW_GPLV3_GDBSERVER}' else ''} \
"

# If GPL-3.0 is in INCOMPATIBLE_LICENSE, and gdbserver/gdb isn't whitelisted,
# then remove gdbserver from the codebench-debug image feature, otherwise the
# build will fail.
FEATURE_PACKAGES_codebench-debug:remove = "${@'gdbserver' if any_incompatible(d, ['gdbserver-external', 'gdb'], 'GPL-3.0-only') else ''}"

INHERIT += "incompatible-packages-check"
```

## meta-mel/conf/distro/include/jobs-heuristic.inc
```bitbake
# Set bitbake threads and make jobs based upon available memory per CPU core.
# Based on https://elinux.org/images/d/d4/Goulart.pdf, a talk done by Mario Domenech
# Goulart and Mikko Rapeli from BMW CAR IT GMBH.
#
# MEM_PER_CPU_MINIMUM,THREADS,JOBS,ACTION
JOBS_HEURISTIC_THRESHOLDS ?= "\
    7.9,cpus,cpus*1.5, \
    3.9,cpus,cpus, \
    1.9,cpus//2,cpus//2,WARN \
    0,,,FATAL \
"

# This function postpones warnings to reduce duplication, and postpones failures
# to avoid breaking bitbake -e.
python jobs_heuristic() {
    """Set bitbake threads and make jobs based upon available memory per CPU core."""
    cpus = oe.utils.cpu_count()
    try:
        mem_total = mem_total_gigs()
    except Exception:
        d.setVar('JOBS_HEURISTIC_WARNING',
                 'Failed to determine system total memory for threads and jobs heuristic.')
        return
    mem_per_cpu = mem_total / cpus

    if cpus == 1:
        threads, jobs = 1, 1
    else:
        for entry in d.getVar('JOBS_HEURISTIC_THRESHOLDS').split():
            split = entry.split(',')
            try:
                required_mem_per_cpu, threads, jobs, action = split
            except ValueError:
                d.setVar('JOBS_HEURISTIC_ERROR',
                         'Invalid entry in JOBS_HEURISTIC_THRESHOLDS: %s. Expected: MEM_PER_CPU_MINIMUM,THREADS,JOBS,ACTION' % entry)
                return

            if mem_per_cpu >= float(required_mem_per_cpu):
                if action:
                    if action == 'FATAL':
                        d.setVar('JOBS_HEURISTIC_ERROR',
                                 'Not enough memory per CPU core (~%s Gb) in this system, exiting.' % int(mem_per_cpu))
                        return
                    elif action == 'WARN':
                        d.setVar('JOBS_HEURISTIC_WARNING',
                                 'Low memory per CPU core (~%s Gb) in this system, parallelization has been scaled down.' % int(mem_per_cpu))

                try:
                    threads = int(eval(threads)) if threads else 1
                except Exception as exc:
                    d.setVar('JOBS_HEURISTIC_ERROR',
                             'Failed to evaluate threads (%s) in JOBS_HEURISTIC_THRESHOLDS entry %s: %s' % (
                                threads, entry, exc))
                    return

                try:
                    jobs = int(eval(jobs)) if jobs else 1
                except Exception as exc:
                    d.setVar('JOBS_HEURISTIC_ERROR',
                             'Failed to evaluate jobs (%s) in JOBS_HEURISTIC_THRESHOLDS entry %s: %s' % (
                                jobs, entry, exc))
                    return
                break
        else:
            return

    bb.debug(1, 'Memory per CPU core is %s, adjusting BB_NUMBER_THREADS to %s and PARALLEL_MAKE to %s' %
                  (mem_per_cpu, threads, jobs))
    d.setVar('BB_NUMBER_THREADS_HEURISTIC', str(max(threads, 1)))
    d.setVar('PARALLEL_MAKE_HEURISTIC', '-j %s' % max(jobs, 1))
}
jobs_heuristic[eventmask] = "bb.event.ConfigParsed"
addhandler jobs_heuristic

def mem_total_gigs():
    if os.path.exists('/proc/meminfo'):
        with open('/proc/meminfo', 'rb') as f:
            splitlines = [l.split()[:2] for l in f.readlines()]
            data = dict((k.strip()[:-1].decode('utf-8'), int(v.strip())) for k, v in splitlines)
            total = data.get('MemTotal')
            if total:
                return total / 1024 / 1024

python jobs_heuristic_sanity() {
    """Inform the user about issues with their system resources."""
    fatal = d.getVar('JOBS_HEURISTIC_ERROR')
    if fatal:
        bb.fatal(fatal)

    warn = d.getVar('JOBS_HEURISTIC_WARNING')
    if warn:
        bb.warn(warn)
}
jobs_heuristic_sanity[eventmask] = "bb.event.SanityCheck bb.build.BuildStarted"
addhandler jobs_heuristic_sanity
```

## meta-mel/conf/distro/include/kernel-link.inc
```bitbake
python add_kernel_imgtype_link () {
    if oe.utils.inherits(e.data, 'kernel'):
        e.data.setVar('kernel_do_deploy_append', 'kernel_imgtype_link\n')
}
add_kernel_imgtype_link[eventmask] = "bb.event.RecipePreFinalise"
addhandler add_kernel_imgtype_link

kernel_imgtype_link () {
    ln -sf ${KERNEL_IMAGE_BASE_NAME}.bin ${KERNEL_IMAGETYPE}
}
```

## meta-mel/conf/distro/include/mel-arm-tuning.inc
```bitbake
# Use common compatible tuning values.
#
# This avoids unnecessary toolchain component rebuilds and increases reuse and compatibility amongst
# compatible machines.
#
# Imported from https://github.com/96boards/meta-rpb/blob/master/conf/distro/include/arm-defaults.inc
# Imported from https://github.com/Angstrom-distribution/meta-angstrom/blob/master/conf/distro/include/arm-defaults.inc

def get_generic_tune(d):
    features = d.getVar('TUNE_FEATURES').split()
    if 'aarch64' in features:
        tune = 'armv8a'
        if 'crc' in features:
            tune += '-crc'
        if 'crypto' in features:
            tune += '-crypto'
    # cortexa* tune files only list 'arm' in features instead of 'armv7*'
    elif 'armv7a' in features or 'armv7ve' in features or ('arm' in features and 'neon' in features):
        tune = 'armv7athf'
        if 'bigendian' in features:
            tune += 'b'
        if 'neon' in features:
            tune += '-neon'
    else:
        tune = d.getVar('DEFAULTTUNE')
    return tune

DEFAULTTUNE:mel := "${@get_generic_tune(d)}"
```

## meta-mel/conf/distro/include/mel-providers.conf
```bitbake
PREFERRED_PROVIDER_gdbserver          ??= "gdbserver"
PREFERRED_PROVIDER_jpeg               ??= "jpeg"
PREFERRED_PROVIDER_jpeg-native        ??= "jpeg-native"
PREFERRED_PROVIDER_rpcbind            ??= "rpcbind"
PREFERRED_PROVIDER_virtual/gettext    ??= "gettext"
PREFERRED_PROVIDER_libx11             ??= "libx11"

# Locked down versions of git kernel recipes for release
PREFERRED_PROVIDER_virtual/kernel_minnow ?= "linux-minnow"
PREFERRED_PROVIDER_virtual/kernel_qemuarm ?= "linux-qemuarm"
PREFERRED_PROVIDER_virtual/kernel_qemux86 ?= "linux-qemux86"
PREFERRED_PROVIDER_virtual/kernel_qemuppc ?= "linux-qemuppc"
```

## meta-mel/conf/distro/include/mel-vardeps.conf
```bitbake
# Ensure that any variable which includes the --sysroot (CC, CXX, etc) also
# depends on the toolchain version
TOOLCHAIN_OPTIONS[vardeps] += "CSL_VER_MAIN CSL_VER_GCC"

#handles reusing of cache build on i86 machine
PACKAGE_ARCH[vardepsexclude] = "BUILD_ARCH"
#handles reusage of base-files recipe
DISTRO_VERSION[vardepsexclude] = "DATE"
#handles reusage of cached-binaries of one machine for other machine
MACHINEOVERRIDES[vardepsexclude] = "MACHINE"
MACHINE_ARCH[vardepsexclude] = "MACHINE"
#handles reusing of cached-binaries for xserver-xorg
XINERAMA[vardepsexclude] = "MACHINE"
#handles reusing of cached-binaries for netbase
do_install[vardepsexclude] = "MACHINE"
```

## meta-mel/conf/distro/include/mel-versions.conf
```bitbake
PREFERRED_VERSION_udev ?= "182"
PREFERRED_VERSION_udev_am37x-evm = "164"
PREFERRED_VERSION_udev_dm37x-evm = "164"

PREFERRED_VERSION_connman_p1020rdb ?= "1.28"
PREFERRED_VERSION_connman_p2020rdb ?= "1.28"
PREFERRED_VERSION_connman_t4240rdb-64b ?= "1.28"

PREFERRED_VERSION_connman_amd ?= "1.28"

include conf/distro/include/qt5-versions.inc
```
