## meta-mel/conf/distro/include/mel.conf
```bitbake
## MEL Base Configuration {{{1
DISTRO = "mel"
ADE_DISTRO = "mel-flex-os"
DISTRO_NAME = "Mentor Embedded Linux Flex OS"
DISTRO_CODENAME = "dunfell"
MAINTAINER = "Siemens Digital Industries Software <embedded_support@mentor.com>"
HOME_URL = "https://www.mentor.com/embedded-software/linux/mel-flex-os/"
SUPPORT_URL = "https://support.sw.siemens.com/"
BUG_REPORT_URL = "https://support.sw.siemens.com/"
ADE_PROVIDER = "${DISTRO_NAME}"
TARGET_VENDOR = "-mel"
SDK_VENDOR = "-melsdk"

# Distro and release versioning
DISTRO_VERSION = "12"
ARCHIVE_RELEASE_VERSION = "${DISTRO_VERSION}.${BSP_VERSION}.${PATCH_VERSION}"
PDK_LICENSE_VERSION_DATE = "20181206"

# Version of the mel-scripts artifact, including setup-mel
SCRIPTS_VERSION ?= "1"

# Default values for BSP and PATCH version, to be redefined in other layers
BSP_VERSION ?= "0"
PATCH_VERSION ?= "0"

SDK_VERSION := "${@'${DISTRO_VERSION}'.replace('snapshot-${DATE}','snapshot')}"
DISTRO_VERSION[vardepsexclude] = "DATE"
SDK_VERSION[vardepsexclude] = "DATE"

SDK_NAME = "${DISTRO}-${TCLIBC}-${SDK_ARCH}-${IMAGE_BASENAME}-${TUNE_PKGARCH}"
SDKPATH = "/opt/${DISTRO}/${SDK_VERSION}"

TCLIBCAPPEND = ""

MEL_DEFAULT_EXTRA_RDEPENDS = "packagegroup-core-boot"
MEL_DEFAULT_EXTRA_RRECOMMENDS = "kernel-module-af-packet"
DISTRO_EXTRA_RDEPENDS += " ${MEL_DEFAULT_EXTRA_RDEPENDS}"
DISTRO_EXTRA_RRECOMMENDS += " ${MEL_DEFAULT_EXTRA_RRECOMMENDS}"

QEMUDEPS = "${@bb.utils.contains('INCOMPATIBLE_LICENSE', 'GPL-3.0', '', 'packagegroup-core-device-devel',d)}"
DISTRO_EXTRA_RDEPENDS_append_qemuarm = " ${QEMUDEPS}"
DISTRO_EXTRA_RDEPENDS_append_qemuarm64 = " ${QEMUDEPS}"
DISTRO_EXTRA_RDEPENDS_append_qemumips = " ${QEMUDEPS}"
DISTRO_EXTRA_RDEPENDS_append_qemuppc = " ${QEMUDEPS}"
DISTRO_EXTRA_RDEPENDS_append_qemux86 = " ${QEMUDEPS}"
DISTRO_EXTRA_RDEPENDS_append_qemux86-64 = " ${QEMUDEPS}"

QEMU_TARGETS ?= "arm aarch64 i386 mips mipsel mips64 mips64el nios2 ppc x86_64"
# Other QEMU_TARGETS "sh4"

PREMIRRORS ??= "\
bzr://.*/.*   http://downloads.yoctoproject.org/mirror/sources/ \n \
cvs://.*/.*   http://downloads.yoctoproject.org/mirror/sources/ \n \
git://.*/.*   http://downloads.yoctoproject.org/mirror/sources/ \n \
gitsm://.*/.* http://downloads.yoctoproject.org/mirror/sources/ \n \
hg://.*/.*    http://downloads.yoctoproject.org/mirror/sources/ \n \
osc://.*/.*   http://downloads.yoctoproject.org/mirror/sources/ \n \
p4://.*/.*    http://downloads.yoctoproject.org/mirror/sources/ \n \
svn://.*/.*   http://downloads.yoctoproject.org/mirror/sources/ \n"

MIRRORS =+ "\
ftp://.*/.*      http://downloads.yoctoproject.org/mirror/sources/ \n \
http://.*/.*     http://downloads.yoctoproject.org/mirror/sources/ \n \
https://.*/.*    http://downloads.yoctoproject.org/mirror/sources/ \n"

# The CONNECTIVITY_CHECK_URI's are used to test whether we can succesfully
# fetch from the network (and warn you if not). To disable the test set
# the variable to be empty.
# Git example url: git://git.yoctoproject.org/yocto-firewall-test;protocol=git;rev=master
CONNECTIVITY_CHECK_URIS ?= "https://www.example.com/"

# Easier adjustment of oe-core QA check defaults
WARN_TO_ERROR_QA ??= ""
WARN_QA_remove = "${WARN_TO_ERROR_QA}"
ERROR_QA_append = " ${WARN_TO_ERROR_QA}"


META_MENTOR_DIR = "${LAYERDIR_mel}/.."
PATH_prepend = "${META_MENTOR_DIR}/scripts:"

# Default to the external toolchain if available
TCMODE ?= "${@bb.utils.contains('BBFILE_COLLECTIONS', 'sourcery', 'external-sourcery-rebuild-libc', bb.utils.contains('BBFILE_COLLECTIONS', 'external-toolchain', 'external', 'default', d), d)}"

# We want media to auto-mount
DISTRO_EXTRA_RRECOMMENDS += "udev-extraconf"

# Paths
MELDIR ?= "${COREBASE}/.."

# Use a local PR server by default
PRSERV_HOST ?= "localhost:0"

# Default to ipk packaging
PACKAGE_CLASSES ?= "package_ipk"

# MEL's supported hosts
SANITY_TESTED_DISTROS = "\
    ubuntu-18.04 \n\
    ubuntu-20.04 \n\
    centos-7* \n \
    centoslinux-7* \n \
    debian-10* \n \
    rhel*-8* \n \
    redhatenterprise*-8* \n \
"

# Sane default append for the kernel cmdline (not used by all BSPs)
# TODO: rename APPEND to something more appropriate
APPEND ?= "${APPEND_SERIAL} console=tty0 ${APPEND_SPLASH}"

APPEND_SPLASH = "${@'quiet splash' if '${SPLASH}' else ''}"
APPEND_SPLASH .= "${@' plymouth:ignore-serial-consoles' if '${SPLASH}' == 'plymouth' else ''}"

APPEND_SERIAL = "${@'console=${CMD_SERIAL_CONSOLE}' if '${SERIAL_CONSOLE}' else ''}"
CMD_SERIAL_CONSOLE ?= "${@','.join(reversed('${SERIAL_CONSOLE}'.split()))}"

APPEND_KGDBOC = "kgdbwait kgdboc=${CMD_SERIAL_CONSOLE}"

# Splash screen
SPLASH_mel ?= "psplash"
PLYMOUTH_THEME ?= "mel"
PLYMOUTH_SHOWDELAY ?= "0"
DISTRO_EXTRA_RRECOMMENDS += "${@'plymouth-mel' if '${SPLASH}' == 'plymouth' else ''}"

# Configuring plymouth to use the logo rather than modifying the theme script
# to use it is a tradeoff. It lets you switch themes while keeping the same
# splash screen, which is nice, the downside is a change to the logo requires
# recompilation of plymouth.
PLYMOUTH_LOGO ?= "${datadir}/plymouth/themes/mel/mel.png"
LOGO_pn-plymouth = "${PLYMOUTH_LOGO}"

UBI_VOLNAME = "rootfs"

IMAGE_FSTYPES ?= "ext4"
ARCHIVE_RELEASE_IMAGE_FSTYPES_EXCLUDE ?= "tar.bz2"

# If a wic image type is enabled, also enable wic.bmap
require conf/distro/include/wic-bmap.inc

# Additional dependencies for deployed files are often pulled in via
# do_image_wic[depends], to ensure the files are available for
# IMAGE_BOOT_FILES, but this bypasses the do_image[recrdeptask] on
# do_populate_lic. Add it for do_image_wic as well.
do_image_wic[recrdeptask] += "do_populate_lic"

# do_image_complete requires licenses, so add recursive dependency
# on do_populate_lic
do_image_complete[recrdeptask] += "do_populate_lic"

# Quadruple the normal. 'du' is not a good way to really see how much
# space will be needed and fails badly as the fs size grows.
IMAGE_ROOTFS_EXTRA_SPACE = "40960"

# Default locale for images
IMAGE_LINGUAS ?= "en-us"

# Ensure the emitted locale packages are in that section, so they can be
# easily excluded from the ADE (or categorized correctly, when included)
LOCALE_SECTION = "locale"

# We aren't quite so picky as poky, but we do want host user contamination to
# be an error.
WARN_TO_ERROR_QA = "host-user-contaminated"

# Also check for host user contamination in the rootfs
ROOTFS_POSTPROCESS_COMMAND_append = " rootfs_check_host_user_contaminated;"

# Used by the host user contamination check
HOSTTOOLS += "id"

# Default to systemd, not sysvinit
VIRTUAL-RUNTIME_init_manager ?= "systemd"
VIRTUAL-RUNTIME_initscripts ?= ""
DISTRO_FEATURES_BACKFILL_CONSIDERED ?= "sysvinit"
DISTRO_FEATURES_append = " systemd"

# Support shallow git tarballs
BB_GENERATE_SHALLOW_TARBALLS ?= "1"
BB_GIT_SHALLOW ?= "1"

BB_GIT_SHALLOW_DEPTH_DEFAULT ?= "1"
BB_GIT_SHALLOW_DEPTH ??= "${@'${BB_GIT_SHALLOW_DEPTH_DEFAULT}' if not '${BB_GIT_SHALLOW_REVS}' else '0'}"
BB_GIT_SHALLOW_REVS ??= ""

# For private repositories, we want to ship the user the history which they
# can't easily re-acquire from upstream.
LINUX_VERSION_TAG ??= "v${@'.'.join('${LINUX_VERSION}'.split('.')[:2])}"
LINUX_VERSION ??= ""
BB_GIT_SHALLOW_REVS_pn-linux-mel ??= "${@'${LINUX_VERSION_TAG}' if '${LINUX_VERSION_TAG}' and '${LINUX_VERSION}' else ''}"

# Export path variables into the devshell for convenience
OE_TOPDIR = "${TOPDIR}"
OE_WORKDIR = "${WORKDIR}"
OE_TERMINAL_EXPORTS += "OE_TOPDIR OE_WORKDIR COREBASE"

require conf/distro/include/no-static-libs.inc
require conf/distro/include/yocto-uninative.inc

INHERIT += "uninative"
## Distro Features & Recipe Configuration {{{1
MEL_DEFAULT_DISTRO_FEATURES = "largefile opengl multiarch"

# This violates typical MACHINE/DISTRO boundaries, but is part of MEL's
# supported features. If the vendor supports x11 and not wayland for its
# machines, so do we.
DISTRO_FEATURES_DEFAULT_remove = "x11"
MEL_DEFAULT_DISTRO_FEATURES += "${@bb.utils.contains('MACHINE_FEATURES', 'x11', \
                                   bb.utils.contains('MACHINE_FEATURES', 'wayland', 'wayland', 'x11', d), 'wayland', d)}"

# Ease distro feature removal via local.conf
DISTRO_FEATURES_REMOVE ??= ""
DISTRO_FEATURES_remove = "${DISTRO_FEATURES_REMOVE}"

DISTRO_FEATURES ?= "${DISTRO_FEATURES_DEFAULT} ${DISTRO_FEATURES_LIBC} ${MEL_DEFAULT_DISTRO_FEATURES}"

# We always want vfat support in our distro for external media
DISTRO_FEATURES_append = " vfat"

# Ensure fbset is in busybox configuration, and fbset-modes is included
PACKAGECONFIG_append_pn-busybox = " fbset"

# Since many embedded systems don't have non-root users, allow autospawn for
# root as well.
PACKAGECONFIG_append_pn-pulseaudio = " autospawn-for-root"

# The PACKAGECONFIG_REMOVE indirection exists to make it possible to override
# the removals, as bitbake doesn't provide a mechanism to do so yet
PACKAGECONFIG_REMOVE ??= ""
PACKAGECONFIG_remove = "${PACKAGECONFIG_REMOVE}"

# We prefer EGL to GLX
PACKAGECONFIG_REMOVE_pn-mesa-demos = "glx"

# We don't use dracut to build initramfs
PACKAGECONFIG_REMOVE_pn-plymouth = "initrd"

# Do not fetch the anti-virus db at compile-time
INSTALL_CLAMAV_CVD ?= ""
## }}}1
## Inherits {{{1
# We want information about package and image contents
INHERIT += "buildhistory"
BUILDHISTORY_COMMIT ?= "1"

# Copy the image license manifest into DEPLOY_DIR_IMAGE
INHERIT += "deploy-license-manifest"

# Support USER_FEATURES
INHERIT += "user_features"

# Do an up front type check to sanity check user configuration
INHERIT += "typecheck"

# Import oe.terminal to allow a type check of OE_TERMINAL
OE_IMPORTS += "oe.terminal"

# Warn if there are available update layers which are not included in the
# current configuration
INHERIT += "mentor-updates-check"

# Check PDK license
INHERIT += "${@bb.utils.contains('BBFILE_COLLECTIONS', 'mentor-private', 'pdk-license', '', d)}"

EXTERNAL_SETUP_SCRIPT_VARS += "REAL_MULTIMACH_TARGET_SYS"
CB_MBS_OPTIONS[general.yocto.sdk.value] = "${EXTERNAL_REAL_MULTIMACH_TARGET_SYS}"

# Warn the user and disable rootfs resizing for non-GPLv3 builds
INHERIT += "resize-rootfs-gplv3"

# Ensure that our DISTRO_CODENAME aligns with LAYERSERIES_CORENAMES
INHERIT += "codename_is_corename"

# Use our toolchain relocation scripts
INHERIT += "${@bb.utils.contains('BBFILE_COLLECTIONS', 'mentor-staging', 'toolchain_ship_relocate_sdk', '', d)}"
TOOLCHAIN_SHAR_REL_TMPL = "${LAYERDIR_mentor-staging}/files/toolchain-shar-relocate.sh"
TOOLCHAIN_EXT_REL_TMPL = "${LAYERDIR_mentor-staging}/files/toolchain-shar-extract.sh"
RELOCATE_SDK_SH ?= "${LAYERDIR_mentor-staging}/files/relocate_sdk.sh"
## }}}1
## Preferences & Package Selection {{{1
# Prefer this version for patchinfo for python3
PREFERRED_VERSION_python3-unidiff-native = "0.6.0"

# Default to the Xorg X server if the BSP doesn't specify
XSERVER ??= "\
    xserver-xorg \
    xf86-input-evdev \
    xf86-input-mouse \
    xf86-input-keyboard \
    xf86-video-fbdev \
"

# Obey our graphics image feature
SYSTEMD_DEFAULT_TARGET ?= '${@bb.utils.contains_any("IMAGE_FEATURES", ["x11-base", "graphics", "x11-sato"], "graphical.target", "multi-user.target", d)}'

# We split out the initramfs install script bits into
# core-image-minimal-install-initramfs, to keep core-image-minimal-initramfs
# as generic as possible, but image-live may well expect the install bits.
INITRD_IMAGE_LIVE ?= "core-image-minimal-install-initramfs"

# Additional package groups
#
# We prefer wayland/weston, unless the vendor supports x11 but not wayland.
FEATURE_PACKAGES_mel-weston = "weston weston-init weston-examples"
FEATURE_PACKAGES_mel-x11 = "${FEATURE_PACKAGES_x11-base} ${FEATURE_PACKAGES_hwcodecs}"
FEATURE_PACKAGES_graphics += "${@bb.utils.contains('DISTRO_FEATURES', 'wayland', '${FEATURE_PACKAGES_mel-weston}', '', d)}"
FEATURE_PACKAGES_graphics += "${@bb.utils.contains('DISTRO_FEATURES', 'x11', '${FEATURE_PACKAGES_mel-x11}', '', d)}"
FEATURE_PACKAGES_tools-audio     ?= "packagegroup-tools-audio"
FEATURE_PACKAGES_tools-benchmark ?= "packagegroup-tools-benchmark"
FEATURE_PACKAGES_multimedia      ?= "gstreamer1.0 gstreamer1.0-plugins-base gstreamer1.0-plugins-good gstreamer1.0-plugins-bad"
FEATURE_PACKAGES_virtualization  ?= "docker-ce python3-docker-compose"
FEATURE_PACKAGES_codebench-debug ?= "gdbserver strace openssh-sftp-server"

# Baseline runtime for third party multilib executables.
# libc/libgcc/libstdc++, plus lttng for tracing. Only applies to images
# without MLPREFIX set (i.e. development-image, not lib32-development-image).
MULTILIB_RUNTIME_PACKAGES = "glibc libgcc libstdc++ ${@bb.utils.contains('IMAGE_FEATURES', 'tools-profile', 'lttng-ust', '', d)}"
MULTILIB_RUNTIME_FEATURE_PACKAGES = "${@' '.join(multilib_pkg_extend(d, pkg) for pkg in d.getVar('MULTILIB_RUNTIME_PACKAGES').split())}"
FEATURE_PACKAGES_multilib-runtime ?= "${@d.getVar('MULTILIB_RUNTIME_FEATURE_PACKAGES') if not d.getVar('MLPREFIX') else ''}"

# Analogous to the nfs-server group
FEATURE_PACKAGES_samba-server    ?= "samba swat"

# Include nss-myhostname for sysvinit, so the hostname resolves. systemd
# includes myhostname itself.
DISTRO_EXTRA_RRECOMMENDS += "${@bb.utils.contains('DISTRO_FEATURES', 'systemd', '', 'nss-myhostname', d)}"
## }}}1
## Workarounds & Overrides {{{1
# Ensure that the output directory always exists, this fixes use of meta-sca
# with certain meta-imx recipes.
do_sca_tracefiles[dirs] =+ "${SCA_SOURCES_DIR}"

# qemu (g-ir-scanner-qemuwrapper) keeps segfaulting in vte, bypass the issue for now
GI_DATA_ENABLED_pn-vte_x86-64 = "False"

# We aren't supporting meta-intel's RMC
BBMASK += "/meta-intel/common/recipes-bsp/systemd-boot/"

# webkitgtk link fails due to memory exhaustion, so disable debug info to
# reduce the memory footprint
DEBUG_FLAGS_remove_pn-webkitgtk = "-g"

# Explicitly remove the proprietary stuff
MACHINE_HWCODECS = ""

# Work around missing vardep bug in bitbake
sstate_stage_all[vardeps] += "sstate_stage_dirs"
## }}}1
## SDK & Application Development Environment {{{1
# As we remove the toolchain from the sdk, naming it 'toolchain' is not
# accurate, and sdk better describes what it is anyway.
TOOLCHAIN_OUTPUTNAME ?= "${SDK_NAME}-sdk-${SDK_VERSION}"

# Add KERNEL_* to the SDK environment (unexported) for use by the user
TOOLCHAIN_TARGET_TASK_append = " sdk-env-kernelvars"

# This allows us to control what base target packages are installed for the
# configured multilibs, by altering SDK_MULTILIB_VARIANTS to differ from
# MULTILIB_VARIANTS. We also append meta-environment to obey
# SDK_MULTILIB_VARIANTS as well.
IMAGE_CLASSES += "image-sdk-multilib-variants"

# Cull duplicate/invalid files for windows SDKMACHINEs
IMAGE_CLASSES += "${@bb.utils.contains('BBFILE_COLLECTIONS', 'mentor-staging', 'win_sdk_cull', '', d)}"

# We need to ensure we can distribute downloads for SDK/ADE builds
IMAGE_CLASSES += "archive_sdk_downloads"

# Create a 'latest' symlink for the SDK
IMAGE_CLASSES += "sdk_latest_link"

# If meta-mentor-private is available, pull in the populate-ade class
ADE_IMAGE_CLASS = "${@bb.utils.contains('BBFILE_COLLECTIONS', 'mentor-private', 'populate_ade archive_ade_downloads', '', d)}"
IMAGE_CLASSES += "${ADE_IMAGE_CLASS}"
## }}}1
## MEL Releases {{{1
# Default image for our installers
RELEASE_IMAGE ?= "development-image"
RELEASE_ARTIFACTS ?= "mel_layers mel_downloads templates images"

# Apply any release-time srcrev lockdowns for AUTOREV recipes
include ${MELDIR}/${MACHINE}/conf/autorevs.conf

# LAYERDIRs for our layers, by name
INHERIT += "layerdirs"

# Layer name and path for the recipe
RECIPE_LAYERNAME = "${@bb.utils.get_file_layer('${FILE}', d) or 'UNKNOWN'}"
RECIPE_LAYERDIR = "${LAYERDIR_${RECIPE_LAYERNAME}}"
LAYERDIR_UNKNOWN = 'UNKNOWN'

# Populate a tree of downloads organized by layer
ARCHIVE_RELEASE_DL_DIR ?= "${DEPLOY_DIR}/release-downloads"
DL_LICENSE_INCLUDE ?= "*"
INHERIT += "archive-release-downloads"

# For our forks, also point an 'upstream' remote at upstream
UPSTREAM_URL = ""
UPSTREAM_URL_bitbake = "https://github.com/openembedded/bitbake"
UPSTREAM_URL_openembedded-core = "https://github.com/openembedded/openembedded-core"

FORKED_REPOS ?= "bitbake openembedded-core"
PUBLIC_REPOS ?= "meta-mentor meta-sourcery meta-tracing ${FORKED_REPOS}"

# Define a location for placing external artifacts to be used by the build
MEL_EXTERNAL_ARTIFACTS ?= "${TOPDIR}/mel-external-artifacts"
## }}}1
## Includes {{{1
# Ensure that we implement shared state reuse handling for non-target recipes
require conf/distro/include/sstate.inc

# Support for SOURCERY_VERSION_REQUIRED
require conf/distro/include/sourcery-version-check.inc

# Sanely handle the GPLv3 gdbserver coming from external-sourcery-toolchain
require conf/distro/include/gdbserver-gplv3.inc

# Handle building blocks
require conf/blocks/bluetooth.conf
require conf/blocks/speech-synthesis.conf
require conf/blocks/speech-recognition.conf

# QT5 configuration. These are includes rather than requires, as they live in
# other layers.
include conf/distro/include/qt5-mel.conf
include conf/distro/include/qt5-versions.inc

# Security configuration.
include conf/distro/include/mel-security.conf

# SWUpdate configuration.
include conf/distro/include/mel-swupdate.conf

# MCF configuration
include conf/distro/include/mel-mcf.conf

# INITRAMFS
INITRAMFS_IMAGE ?= "mel-initramfs-image"
INITRAMFS_IMAGE_BUNDLE ?= "1"

## }}}1
# vim: set fdm=marker fdl=0 :
```
