## meta-mentor-staging/conf/layer.conf
```bitbake
BBPATH .= ":${LAYERDIR}"
BBFILES += "${LAYERDIR}/recipes-*/*/*.bb \
            ${LAYERDIR}/recipes-*/*/*.bbappend"

# Let us add layer-specific bb/bbappends which are only applied when that
# layer is included in our configuration
BBFILES += "${@' '.join('${LAYERDIR}/%s/recipes*/*/*.bbappend' % layer \
               for layer in BBFILE_COLLECTIONS.split())}"
BBFILES += "${@' '.join('${LAYERDIR}/%s/recipes*/*/*.bb' % layer \
               for layer in BBFILE_COLLECTIONS.split())}"

LAYERDIR_RE ?= "${LAYERDIR}"
LAYERDIR_mentor-staging = "${LAYERDIR}"
BBFILE_COLLECTIONS += "mentor-staging"
BBFILE_PRIORITY_mentor-staging = "10"
BBFILE_PATTERN_mentor-staging = "^${LAYERDIR_RE}/"
LAYERDEPENDS_mentor-staging = "core mentor-common"
LAYERSERIES_COMPAT_mentor-staging = "thud warrior zeus gatesgarth"

# We don't want systemd and everything depending on systemd to rebuild when
# the metadata stored in os-release changes. TODO: push this to oe-core
SIGGEN_EXCLUDERECIPES_ABISAFE_append_feature-mentor-staging = " os-release"

INHERIT_append = " feature_overrides"
FEATUREOVERRIDES .= "${@bb.utils.contains('DISTRO_FEATURES', 'mentor-staging', ':feature-mentor-staging', '', d)}"
```
